/*
 * This file is part of the 
 *
 * Copyright (c) 2017-2018 linghaibin
 *
 */
 
#include "analog_quantity.h"
#include "delay.h"
#include "flash.h"
#include "can.h"

struct kanlman_val {
     double PreOptimalVar;                       //先前最优值
     double CurMeasVar;
     double CurEstimateVar;        //当前测量值，当前预测值
     double CurOptimalVar;                      //当前最优值
     double CurSysCoVar;
     double PreSysCoVar;         //当前系统协方差，先前系统协方差
     double KalmanGain;                         //卡尔曼增益
     uint32_t AdjustVar;
};

struct kanlman_val k_val[8];

static uint16_t adc_value[9];
static uint16_t average_value[8];
static ads_read_mode al_am[8] = {AM_NULL,AM_NULL,AM_NULL,AM_NULL,AM_NULL,AM_NULL,AM_NULL,AM_NULL};
/* Private macro -------------------------------------------------------------*/
/* Private variables ---------------------------------------------------------*/
const float pt100_table[1491] = {
    80.7033,80.66036,80.6239,80.5842,80.5445,80.5048,80.4651,80.4254,80.3857,80.346,
    81.1003,81.0606,81.0209,80.9812,80.9415,80.9018,80.8621,80.8224,80.7827,80.743,
    81.497,81.4573,81.4177,81.378,81.3383,81.2987,81.259,81.2193,81.1796,81.14,
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    138.1262, 138.1641, 138.2020, 138.2400, 138.2779, 138.3158, 138.3538, 138.3917, 138.4296, 138.4676,
    138.5055
};

const float pt1000_table[1491] = {
807.033 ,806.604 ,806.239 ,805.842 ,805.445 ,805.048 ,804.651 ,804.254 ,803.857 ,803.460 ,
811.003 ,810.606 ,810.209 ,809.812 ,809.415 ,809.018 ,808.621 ,808.224 ,807.827 ,807.430 ,
814.970 ,814.573 ,814.177 ,813.780 ,813.383 ,812.987 ,812.590 ,812.193 ,811.796 ,811.400 ,
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1381.262 ,1381.641 ,1382.020 ,1382.400 ,1382.779 ,1383.158 ,1383.538 ,1383.917 ,1384.296 ,1384.676 ,
1385.055
};

float pt100_res_to_temp(float resistance) {
    uint16_t low = 0;
    uint16_t mid = sizeof(pt100_table) / sizeof(pt100_table[0]) / 2;
    uint16_t high = sizeof(pt100_table) / sizeof(pt100_table[0]) - 1;

    if((resistance < pt100_table[0]) || (resistance > pt100_table[high])) {
        return -100; 
    }
    while(high >= low) {
        mid = (high + low) / 2;
        if(resistance >= pt100_table[mid]) {
            if(resistance < pt100_table[mid + 1]) {
                float temp = (0.1 * low + (resistance - pt100_table[mid]) * 0.1 / ((pt100_table[mid + 1]) - pt100_table[mid]));
                if(resistance >= 100) {
                    return temp-50;
                } else {
                    return 0 - ( 49.9 - temp );
                }
                //break;
            } else {
                low = mid + 1;
            }
        } else if(resistance < pt100_table[mid]) {
            high = mid - 1;
        }
    }
    return 0;
}

float pt1000_res_to_temp(float resistance) {
    uint16_t low = 0;
    uint16_t mid = sizeof(pt1000_table) / sizeof(pt1000_table[0]) / 2;
    uint16_t high = sizeof(pt1000_table) / sizeof(pt1000_table[0]) - 1;

    if((resistance < pt1000_table[0]) || (resistance > pt1000_table[high])) {
        return -100; 
    }
    while(high >= low) {
        mid = (high + low) / 2;
        if(resistance >= pt1000_table[mid]) {
            if(resistance < pt1000_table[mid + 1]) {
                float temp = (0.1 * low + (resistance - pt1000_table[mid]) * 0.1 / ((pt1000_table[mid + 1]) - pt1000_table[mid]));
                if(resistance >= 100) {
                    return temp-50;
                } else {
                    return 0 - ( 49.9 - temp );
                }
                //break;
            } else {
                low = mid + 1;
            }
        } else if(resistance < pt1000_table[mid]) {
            high = mid - 1;
        }
    }
    return 0;
}

/*!
    \brief      configure the DMA peripheral
    \param[in]  none
    \param[out] none
    \retval     none
*/
/*!
    \brief      configure the different system clocks
    \param[in]  none
    \param[out] none
    \retval     none
*/
static void rcu_config(void) {
    rcu_periph_clock_enable(RCU_ADC0); 			 /* enable ADC clock */
    rcu_periph_clock_enable(RCU_DMA0);  		 /* enable DMA0 clock */
    rcu_adc_clock_config(RCU_CKADC_CKAPB2_DIV8); /* config ADC clock */
    rcu_periph_clock_enable(RCU_DAC);
    
    rcu_periph_clock_enable(RCU_GPIOC);
    rcu_periph_clock_enable(RCU_GPIOB);
    rcu_periph_clock_enable(RCU_GPIOA);
}

/*!
    \brief      configure the GPIO peripheral
    \param[in]  none
    \param[out] none
    \retval     none
*/
static void gpio_config(void) {
    gpio_init(GPIOC, GPIO_MODE_AIN, GPIO_OSPEED_50MHZ, GPIO_PIN_1); //11
    gpio_init(GPIOA, GPIO_MODE_AIN, GPIO_OSPEED_50MHZ, GPIO_PIN_0); //0
    gpio_init(GPIOA, GPIO_MODE_AIN, GPIO_OSPEED_50MHZ, GPIO_PIN_3); //3
    gpio_init(GPIOA, GPIO_MODE_AIN, GPIO_OSPEED_50MHZ, GPIO_PIN_5); //12-5

    gpio_init(GPIOC, GPIO_MODE_AIN, GPIO_OSPEED_50MHZ, GPIO_PIN_4); //12-14
    gpio_init(GPIOC, GPIO_MODE_AIN, GPIO_OSPEED_50MHZ, GPIO_PIN_5); //12-15

    gpio_init(GPIOB, GPIO_MODE_AIN, GPIO_OSPEED_50MHZ, GPIO_PIN_0); //12-8
    gpio_init(GPIOB, GPIO_MODE_AIN, GPIO_OSPEED_50MHZ, GPIO_PIN_1); //12-9
    
    gpio_init(GPIOC, GPIO_MODE_AIN, GPIO_OSPEED_50MHZ, GPIO_PIN_0); //10
    
    gpio_init(GPIOA, GPIO_MODE_AIN, GPIO_OSPEED_50MHZ, GPIO_PIN_4);//AD
}

/*!
    \brief      configure the DAC
    \param[in]  none
    \param[out] none
    \retval     none
*/
void dac_config(void) {
    dac_deinit();
    /* configure the DAC1 */
    dac_wave_mode_config(DAC0, DAC_WAVE_DISABLE);
    dac_triangle_noise_config(DAC0, DAC_TRIANGLE_AMPLITUDE_2047);
    dac_output_buffer_enable(DAC0);
    dac_software_trigger_disable(DAC0);
    
    /* enable DAC1 and set data */
    dac_enable(DAC0);//
    float cur = ( 10 * 3 );
    dac_data_set(DAC0, DAC_ALIGN_12B_R, ( ( ( 0xfff * ( cur ) ) / 3.3 ) / 10 ) - 10 );
}

/*!
    \brief      configure the DMA peripheral
    \param[in]  none
    \param[out] none
    \retval     none
*/
static void dma_config(void) {
    /* ADC_DMA_channel configuration */
    dma_parameter_struct dma_data_parameter;
    
    /* ADC DMA_channel configuration */
    dma_deinit(DMA0, DMA_CH0);
    
    /* initialize DMA single data mode */
    dma_data_parameter.periph_addr  = (uint32_t)(&ADC_RDATA(ADC0));
    dma_data_parameter.periph_inc   = DMA_PERIPH_INCREASE_DISABLE;
    dma_data_parameter.memory_addr  = (uint32_t)(&adc_value);
    dma_data_parameter.memory_inc   = DMA_MEMORY_INCREASE_ENABLE;
    dma_data_parameter.periph_width = DMA_PERIPHERAL_WIDTH_16BIT;
    dma_data_parameter.memory_width = DMA_MEMORY_WIDTH_16BIT;  
    dma_data_parameter.direction    = DMA_PERIPHERAL_TO_MEMORY;
    dma_data_parameter.number       = 9;
    dma_data_parameter.priority     = DMA_PRIORITY_HIGH;
    dma_init(DMA0, DMA_CH0, dma_data_parameter);
    dma_circulation_enable(DMA0, DMA_CH0);
  
    /* enable DMA channel */
    dma_channel_enable(DMA0, DMA_CH0);
}

/*!
    \brief      configure the ADC peripheral
    \param[in]  none
    \param[out] none
    \retval     none
*/
static void adc_config(void) {
    adc_external_trigger_source_config(ADC0, ADC_REGULAR_CHANNEL, ADC0_1_2_EXTTRIG_REGULAR_NONE);  /* ADC trigger config */
    adc_external_trigger_config(ADC0, ADC_REGULAR_CHANNEL, ENABLE);
    
    adc_data_alignment_config(ADC0, ADC_DATAALIGN_RIGHT);                         /* ADC data alignment config */
    adc_mode_config(ADC_MODE_FREE);                                               /* ADC mode config */
    adc_channel_length_config(ADC0, ADC_REGULAR_CHANNEL, 9);                      /* ADC channel length config */
    adc_regular_channel_config(ADC0, 0, ADC_CHANNEL_11, ADC_SAMPLETIME_71POINT5); /* ADC regular channel config */
    adc_regular_channel_config(ADC0, 1, ADC_CHANNEL_0, ADC_SAMPLETIME_71POINT5); /* ADC regular channel config */
    adc_regular_channel_config(ADC0, 2, ADC_CHANNEL_3, ADC_SAMPLETIME_71POINT5); /* ADC regular channel config */
    adc_regular_channel_config(ADC0, 3, ADC_CHANNEL_5, ADC_SAMPLETIME_71POINT5); /* ADC regular channel config */
    adc_regular_channel_config(ADC0, 4, ADC_CHANNEL_14, ADC_SAMPLETIME_71POINT5); /* ADC regular channel config */
    adc_regular_channel_config(ADC0, 5, ADC_CHANNEL_15, ADC_SAMPLETIME_71POINT5); /* ADC regular channel config */
    adc_regular_channel_config(ADC0, 6, ADC_CHANNEL_8, ADC_SAMPLETIME_71POINT5); /* ADC regular channel config */
    adc_regular_channel_config(ADC0, 7, ADC_CHANNEL_9, ADC_SAMPLETIME_71POINT5); /* ADC regular channel config */
    adc_regular_channel_config(ADC0, 8, ADC_CHANNEL_10, ADC_SAMPLETIME_71POINT5); /* ADC regular channel config */
    adc_discontinuous_mode_config(ADC0, ADC_REGULAR_CHANNEL, 3);/* ADC discontinuous mode */
    adc_enable(ADC0);/* enable ADC interface */
    delay_ms(1);/* wait adc enable must*/
    adc_calibration_enable(ADC0);/* ADC calibration and reset calibration */
    adc_dma_mode_enable(ADC0);
     /* ADC software trigger enable */
    adc_software_trigger_enable(ADC0, ADC_REGULAR_CHANNEL);
}

/* 标定补偿值 */
static int v1ma_bc = 0;
static int v10ma_bc = 0;
static int vval_bc[16];
static int vcur_bc[16];
static int vpt100_bc = 0;
static int vpt1000_bc = 0;

void analog_quantity_init(void) {
    rcu_config();
    gpio_config();
    dma_config();
    adc_config();
    dac_config();
    uint32_t dat;
    flash_read(C_FLAG,&dat);
    if(dat != 0x55) {
        dat = 0x55;
        flash_write(C_FLAG,dat);
        flash_write(C_1MA_BZ,0x00);
        flash_write(C_10MA_BZ,0x00);
        for(uint8_t i = 0;i < 16;i++) {
            flash_write(C_VAL_BZ+i,0x00);
            vval_bc[i] = 0;
        }
        for(uint8_t i = 0;i < 16;i++) {
            flash_write(C_CUR_BZ+i,0x00);
            vcur_bc[i] = 0;
        }
        flash_write(C_PT100_BZ,0);
        flash_write(C_PT1000_BZ,0);
    } else {
        flash_read(C_1MA_BZ,(uint32_t *)&v1ma_bc);
        flash_read(C_10MA_BZ,(uint32_t *)&v10ma_bc);
        for(uint8_t i = 0;i < 16;i++) {
            flash_read(C_VAL_BZ+i,(uint32_t *)&vval_bc[i]);
        }
        for(uint8_t i = 0;i < 16;i++) {
            flash_read(C_CUR_BZ+i,(uint32_t *)&vcur_bc[i]);
        }
        flash_read(C_PT100_BZ,(uint32_t *)&vpt100_bc);
        flash_read(C_PT1000_BZ,(uint32_t *)&vpt1000_bc);
    }
    
    for(int i = 0;i < 8;i++) {
        k_val[i].AdjustVar = 0;
        k_val[i].PreOptimalVar = 1;
        k_val[i].CurMeasVar = 0;
        k_val[i].CurEstimateVar = 0;
        k_val[i].CurOptimalVar = 0;
        k_val[i].CurSysCoVar = 0;
        k_val[i].PreSysCoVar = 30;
        k_val[i].KalmanGain = 0;
    }
    
}

/* 设置通道模式 */
void analog_quantity_set_ch_mode(ads_read_mode mode,check_channel passageway) {
    if(passageway < 8) {
        read_config_mode(mode,passageway);
        al_am[passageway] = mode;
    }
}

float analog_quantity_get(check_channel ch) {
    if(ch < 8) {
        switch(al_am[ch]) {
            case PT100: {
                return pt100_res_to_temp( (float)( ( (average_value[ch] + vpt100_bc) * 3300 / 0xfff) * 0.1 ) ); //0.1
            }
            case PT1000: {
                return pt1000_res_to_temp( (float)( ( (average_value[ch] + vpt1000_bc) * 3300 / 0xfff) * 1 ) ); //0.1
            }
            case VOLTAGE: {
                if(average_value[ch] + vval_bc[ch*2] >= 0) {
                    return (average_value[ch] + vval_bc[ch*2]) * (10.0 / vval_bc[ch*2+1]);
                } else {
                    return 0;
                }
            }
            case ELE_CURRENT: {
                if(average_value[ch] + vcur_bc[ch*2] >= 0) {
                    return (average_value[ch] + vcur_bc[ch*2]) * (20.0 / vcur_bc[ch*2+1]);
                } else {
                    return 0;
                }
            }
            case AM_NULL: {
                return -1000.0;
            }
        }
    }
    return -1000.0;
}

static uint16_t analog_quantity_get_hex(check_channel ch) {
    if(ch < 8) {
        switch(al_am[ch]) {
            case PT100: {
                read_config_pass_set(ch);
                delay_ms(1);
                dac_data_set(DAC0, DAC_ALIGN_12B_R, 3723 + v10ma_bc );
                delay_ms(10);
                for(uint8_t i = 0; i < 9;i++) {
                    adc_software_trigger_enable(ADC0, ADC_REGULAR_CHANNEL); /* ADC software trigger enable */
                    delay_ms(1);
                }
                return adc_value[8];
            }
            case PT1000: {
                read_config_pass_set(ch);
                delay_ms(1);
                dac_data_set(DAC0, DAC_ALIGN_12B_R, 372 + v1ma_bc );
                delay_ms(10);
                for(uint8_t i = 0; i < 9;i++) {
                    adc_software_trigger_enable(ADC0, ADC_REGULAR_CHANNEL); /* ADC software trigger enable */
                    delay_ms(1);
                }
                return adc_value[8];
            }
            case VOLTAGE: {
                for(uint8_t i = 0; i < 9;i++) {
                    adc_software_trigger_enable(ADC0, ADC_REGULAR_CHANNEL); /* ADC software trigger enable */
                    delay_ms(2);
                }
                return adc_value[ch];
            }
            case ELE_CURRENT: {
                for(uint8_t i = 0; i < 9;i++) {
                    adc_software_trigger_enable(ADC0, ADC_REGULAR_CHANNEL); /* ADC software trigger enable */
                    delay_ms(2);
                }
                return adc_value[ch];
            }
            case AM_NULL: {
                return 0xffff;
            }
        }
    }
    return 0xffff;
}



#define SysNoiseCoVar         (0.08)
#define MeasNoiseCoVar        (30.7415926) //系统噪声协方差，测量噪声协方差

/*卡尔曼滤波需要设置4个值，其余均可自动调整*/
uint16_t KalmanFitterAD1(uint16_t MeasVar, struct kanlman_val * val) {
    
    val->CurMeasVar=MeasVar;                         //当前系统测量值
    //先前系统最优值和先前系统协方差需要设置非零初始值；；；；
    /*当前估计值=先前最优值+调整值*/
    val->CurEstimateVar=val->PreOptimalVar+val->AdjustVar;
    val->AdjustVar=0;                                //设定调整值的原因是加快调整速度
    /*当前系统协方差=先前系统协方差+系统噪声协方差*/
    val->CurSysCoVar=val->PreSysCoVar+SysNoiseCoVar;
    /*卡尔曼增益=当前系统协方差/(当前系统协方差+测量噪声协方差)*/
    val->KalmanGain=val->CurSysCoVar/(val->CurSysCoVar+MeasNoiseCoVar);
    /*当前系统最优值=当前系统估计值+卡尔曼增益*（测量值-当前系统估计值）*/
    val->CurOptimalVar=val->CurEstimateVar+val->KalmanGain*(val->CurMeasVar-val->CurEstimateVar);
    /*先前系统噪声协方差=（1-卡尔曼增益）x当前系统协方差*/
    val->PreSysCoVar =(1-val->KalmanGain)*val->CurSysCoVar;
    val->PreOptimalVar=val->CurOptimalVar;		//递归处理当前系统最优值
    /*返回数据*/
    return (uint16_t)val->CurOptimalVar;
}

void analog_quantity_tic_100ms( void ) {
    static uint8_t count_tic = 0;
    static float val_hex[8];
    if(count_tic < 20) {
        count_tic++;
        for(int i = 0;i < 8;i++) {
            if( (al_am[i] == PT100) || (al_am[i] == PT1000) ) {
                average_value[i] = KalmanFitterAD1(analog_quantity_get_hex((check_channel)i), &k_val[i]);
            } else {
                uint16_t val_y = analog_quantity_get_hex((check_channel)i);
                if(count_tic == 1) {
                    val_hex[i] = val_y;
                } else {
                    val_hex[i] += val_y;
                    val_hex[i] *= 0.5;
                }
            }
        }
    } else {
        count_tic = 0;
        for(int i = 0;i < 8;i++) {
            if( (al_am[i] != PT100) && (al_am[i] != PT1000) ) {
                average_value[i] = val_hex[i];
            }
        }
    }
}

static uint8_t calibration_flag = 0;

uint8_t analog_quantity_calibration_flag_get( void ) {
    return calibration_flag;
}

void analog_quantity_calibration(uint8_t * cmd) {
    calibration_flag = 1;
    switch(cmd[0]) {
        case 0x00: { /* 设置通道模式 */
            if( cmd[1] < 8 ) { /* 通道 */
                analog_quantity_set_ch_mode( (ads_read_mode)cmd[2],(check_channel)cmd[1] );
            } else {
                analog_quantity_set_ch_mode( (ads_read_mode)cmd[2],CC_1 );
                analog_quantity_set_ch_mode( (ads_read_mode)cmd[2],CC_2 );
                analog_quantity_set_ch_mode( (ads_read_mode)cmd[2],CC_3 );
                analog_quantity_set_ch_mode( (ads_read_mode)cmd[2],CC_4 );
                analog_quantity_set_ch_mode( (ads_read_mode)cmd[2],CC_5 );
                analog_quantity_set_ch_mode( (ads_read_mode)cmd[2],CC_6 );
                analog_quantity_set_ch_mode( (ads_read_mode)cmd[2],CC_7 );
                analog_quantity_set_ch_mode( (ads_read_mode)cmd[2],CC_8 );
            }
        } break;
        case 0x01: { /* 设置电流通道 */
            read_config_pass_set((check_channel)cmd[2]);
            delay_ms(5);
            if(cmd[1] == 0) { /* 10ma */
                dac_data_set(DAC0, DAC_ALIGN_12B_R, 3723 + v10ma_bc );
            } else {  /* 1ma */
                dac_data_set(DAC0, DAC_ALIGN_12B_R, 372 + v1ma_bc );
            }
        } break;
        case 0x02: { /* 获取值*/
            switch(cmd[1]) {
                case 0: { //1ma
                    
                } break;
                case 1: { // 10ma
                    
                } break;
                case 2: { // 电压
                    uint16_t xval = 0;
                    
                    for(uint8_t j = 0; j < 20;j++) {
                        for(uint8_t i = 0; i < 9;i++) {
                            adc_software_trigger_enable(ADC0, ADC_REGULAR_CHANNEL); /* ADC software trigger enable */
                            delay_ms(1);
                        }
                        if(j == 1) {
                            xval = adc_value[cmd[2]];
                        } else {
                            xval += adc_value[cmd[2]];
                            xval *= 0.5;
                        }
                        delay_ms(5);
                    }
                    
                    can_trasnmit_message_struct send_msg;
                    send_msg.tx_sfid = 0x0154;
                    send_msg.tx_dlen = 4;
                    send_msg.tx_data[0] = 2; /* 设备类型 */
                    send_msg.tx_data[1] = 2; /* 命令 */
                    send_msg.tx_data[2] = (xval & 0x00ff);
                    send_msg.tx_data[3] = (xval >> 8);
                    bxcan_send(send_msg);
                } break;
                case 3: { // 电流
                    uint16_t xval = 0;
                    
                    for(uint8_t j = 0; j < 20;j++) {
                        for(uint8_t i = 0; i < 9;i++) {
                            adc_software_trigger_enable(ADC0, ADC_REGULAR_CHANNEL); /* ADC software trigger enable */
                            delay_ms(1);
                        }
                        if(j == 1) {
                            xval = adc_value[cmd[2]];
                        } else {
                            xval += adc_value[cmd[2]];
                            xval *= 0.5;
                        }
                        delay_ms(5);
                    }
                    
                    can_trasnmit_message_struct send_msg;
                    send_msg.tx_sfid = 0x0154;
                    send_msg.tx_dlen = 4;
                    send_msg.tx_data[0] = 2; /* 设备类型 */
                    send_msg.tx_data[1] = 3; /* 命令 */
                    send_msg.tx_data[2] = (xval & 0x00ff);
                    send_msg.tx_data[3] = (xval >> 8);
                    bxcan_send(send_msg);
                } break;
                case 4: { //pt100 
                    read_config_pass_set(CC_5);
                    delay_ms(1);
                    dac_data_set(DAC0, DAC_ALIGN_12B_R, 3723 + v10ma_bc );
                    delay_ms(10);
                    
                    uint16_t xval = 0;
                    
                    for(uint8_t j = 0; j < 20;j++) {
                        for(uint8_t i = 0; i < 9;i++) {
                            adc_software_trigger_enable(ADC0, ADC_REGULAR_CHANNEL); /* ADC software trigger enable */
                            delay_ms(1);
                        }
                        if(j == 1) {
                            xval = adc_value[8];
                        } else {
                            xval += adc_value[8];
                            xval *= 0.5;
                        }
                        delay_ms(5);
                    }
                    
                    can_trasnmit_message_struct send_msg;
                    send_msg.tx_sfid = 0x0154;
                    send_msg.tx_dlen = 4;
                    send_msg.tx_data[0] = 2; /* 设备类型 */
                    send_msg.tx_data[1] = 4; /* 命令 */
                    send_msg.tx_data[2] = (xval & 0x00ff);
                    send_msg.tx_data[3] = (xval >> 8);
                    bxcan_send(send_msg);
                } break;
                case 5: { //pt1000 
                    
                    read_config_pass_set(CC_5);
                    delay_ms(1);
                    dac_data_set(DAC0, DAC_ALIGN_12B_R, 372 + v1ma_bc );
                    delay_ms(10);
                    
                    uint16_t xval = 0;
                    
                    for(uint8_t j = 0; j < 20;j++) {
                        for(uint8_t i = 0; i < 9;i++) {
                            adc_software_trigger_enable(ADC0, ADC_REGULAR_CHANNEL); /* ADC software trigger enable */
                            delay_ms(1);
                        }
                        if(j == 1) {
                            xval = adc_value[8];
                        } else {
                            xval += adc_value[8];
                            xval *= 0.5;
                        }
                        delay_ms(5);
                    }
                    
                    can_trasnmit_message_struct send_msg;
                    send_msg.tx_sfid = 0x0154;
                    send_msg.tx_dlen = 4;
                    send_msg.tx_data[0] = 2; /* 设备类型 */
                    send_msg.tx_data[1] = 5; /* 命令 */
                    send_msg.tx_data[2] = (xval & 0x00ff);
                    send_msg.tx_data[3] = (xval >> 8);
                    bxcan_send(send_msg);
                } break;
            }
        } break;
        case 0x03: { /* 修改配置值 */
            switch(cmd[1]) {
                case 0: { //1ma
                    v1ma_bc = cmd[2];
                    v1ma_bc |= (cmd[3] << 8);
                    v1ma_bc |= (cmd[4] << 16);
                    v1ma_bc |= (cmd[5] << 24);
                } break;
                case 1: { // 10ma
                    v10ma_bc = cmd[2];
                    v10ma_bc |= (cmd[3] << 8);
                    v10ma_bc |= (cmd[4] << 16);
                    v10ma_bc |= (cmd[5] << 24);
                } break;
                case 2: { // 电压
                    vval_bc[cmd[2]] = cmd[3];
                    vval_bc[cmd[2]] |= (cmd[4] << 8);
                    vval_bc[cmd[2]] |= (cmd[5] << 16);
                    vval_bc[cmd[2]] |= (cmd[6] << 24);
                } break;
                case 3: { // 电流
                    vcur_bc[cmd[2]] = cmd[3];
                    vcur_bc[cmd[2]] |= (cmd[4] << 8);
                    vcur_bc[cmd[2]] |= (cmd[5] << 16);
                    vcur_bc[cmd[2]] |= (cmd[6] << 24);
                } break;
                case 4: { //pt100
                    vpt100_bc = cmd[2];
                    vpt100_bc |= (cmd[3] << 8);
                    vpt100_bc |= (cmd[4] << 16);
                    vpt100_bc |= (cmd[5] << 24);
                    
                    vpt100_bc = (1241 + vpt100_bc);
                    
                } break;
                case 5: { //pt1000
                    vpt1000_bc = cmd[2];
                    vpt1000_bc |= (cmd[3] << 8);
                    vpt1000_bc |= (cmd[4] << 16);
                    vpt1000_bc |= (cmd[5] << 24);
                    
                    vpt1000_bc = (1241 + vpt1000_bc);
                } break;
            }
        } break;
        case 0x04: { /* 保存配置值 */
            flash_write(C_FLAG,0x55);
            
            flash_write(C_1MA_BZ,v1ma_bc);
            flash_write(C_10MA_BZ,v10ma_bc);
            for(uint8_t i = 0;i < 16;i++) {
                flash_write(C_VAL_BZ+i,vval_bc[i]);
            }
            for(uint8_t i = 0;i < 16;i++) {
                flash_write(C_CUR_BZ+i,vcur_bc[i]);
            }
            flash_write(C_PT100_BZ,vpt100_bc);
            flash_write(C_PT1000_BZ,vpt1000_bc);
            
            calibration_flag = 0;
        } break;
    }
}


